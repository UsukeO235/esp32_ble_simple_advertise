## sdkconfig.defaults
```kconfig
#
# BT config
#
CONFIG_BT_ENABLED=y
CONFIG_BTDM_CTRL_MODE_BLE_ONLY=y
CONFIG_BTDM_CTRL_MODE_BR_EDR_ONLY=n
CONFIG_BTDM_CTRL_MODE_BTDM=n
# Do NOT include these lines below, otherwise "idf.py build" will fail
#CONFIG_BT_BLUEDROID_ENABLED=n
#CONFIG_BT_CONTROLLER_ONLY=y
```
